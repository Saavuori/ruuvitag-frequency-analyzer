## CMakeLists.txt
```
cmake_minimum_required(VERSION 3.20.0)

find_package(Zephyr REQUIRED HINTS $ENV{ZEPHYR_BASE})
project(ruuvitag_frequency_analyzer)

target_sources(app PRIVATE
  src/main.c
  src/sampler.c
  src/power.c
  src/battery.c
  src/lis2dh12.c
  src/gatt_stream.c
  src/env.c
  src/leds.c
  src/fft.c
  src/adv_df5.c
  src/adv_spectrum.c
)
```

## Kconfig
```
menu "RuuviTag frequency analyzer"

# There are deliberately no signal-processing options here.
#
# Transform length, overlap, window function and reference level all live on the
# host, where changing one costs a page reload rather than a reflash (ADR-0003).
# A tuning knob in this file would be a number somebody has to unscrew the tag
# from a wall to change. The only things left are how the board behaves as a
# board - which includes what it costs to run.

config RFA_IDLE_PERIOD_S
	int "Seconds between broadcast spectra when idle"
	default 60
	range 5 3600
	help
	  How often an idle tag wakes the accelerometer to 400 Hz, takes one
	  transform window and queues a 0xC2 spectrum.

	  This is the main battery lever. A burst is ~3 s, so 60 s is roughly a
	  5% duty cycle on the sensor; 10 s would be ~30% and several times the
	  idle draw. It has no effect on a connected capture, which streams
	  continuously either way.

config RFA_WAKE_ON_MOTION
	bool "Burst on the accelerometer's activity interrupt"
	default y
	help
	  Sample when something actually moves, on top of the heartbeat. Worth
	  having on intermittent machinery, where it turns a fixed duty cycle
	  into one that follows the equipment. On something that vibrates
	  continuously it fires constantly and saves nothing - turn it off there
	  and rely on the heartbeat.

config RFA_MOTION_THRESHOLD_MG
	int "Activity threshold (mg)"
	default 256
	range 16 2000
	depends on RFA_WAKE_ON_MOTION
	help
	  Quantised to 16 mg steps at the +/-2 g full scale, and applied after a
	  high-pass filter, so it is a threshold on change rather than on gravity.

	  Note the sensor idles in 8-bit low-power mode, where one LSB is 16 mg -
	  so this is a threshold on a coarse signal, not on the 1 mg resolution
	  the analyser sees during a burst.

	  64 mg was the first guess and it was wrong: on a bench with a steady
	  72 mg component at 44.5 Hz the tag retriggered within ~230 ms of every
	  burst and spent 92% of its life awake. 256 mg clears that. It is still
	  site-specific - use command 0x02 on the Control characteristic to tune
	  it live, watch DF5's movement counter, then set the value you found
	  here.

config RFA_MOTION_DURATION
	int "Samples above threshold before the interrupt fires"
	default 4
	range 1 127
	depends on RFA_WAKE_ON_MOTION
	help
	  The sensor idles at 10 Hz, so 4 samples is ~400 ms of sustained motion
	  before a burst. Raising this rejects knocks and footsteps at the cost of
	  latency; lowering it makes the tag jumpier.

config RFA_ADV_INTERVAL_MS
	int "Advertising interval (ms)"
	default 1000
	range 100 10000
	help
	  Longer is cheaper, but discovery is what sets the floor in practice, not
	  the broadcast spectrum. At the edge of range a scanner only hears a
	  fraction of advertisements, and halving the interval halves the time to
	  find the tag - which at 2000 ms on a weak link was long enough to look
	  like a tag that was not there.

	  A 0xC2 frame takes 8 advertisements, so at 1000 ms one spectrum needs
	  ~8 s to transmit and still fits comfortably inside a 60 s idle period.

config RFA_STATUS_LEDS
	bool "Status LEDs"
	default y
	help
	  Green flashes per advertisement, red solid while a host is streaming.

	  On by default, which is not the cheapest choice and is deliberate. A
	  tag on a battery in another room, with the LEDs off and out of radio
	  range, gives you nothing at all to look at - there is no way to tell a
	  flat cell from a crash from a wall in the way. The flash costs roughly
	  15-20 uA and buys "walk up to it and see that it is alive".

	  Turn it off once a deployment is proven and you trust the link.

config RFA_LED_BOOT_MS
	int "Boot indication (ms)"
	default 200
	depends on RFA_STATUS_LEDS

config RFA_LED_FLASH_MS
	int "Advertisement flash (ms)"
	default 10
	depends on RFA_STATUS_LEDS
	help
	  Short enough to be cheap, long enough to see. Below about 5 ms the
	  flash is hard to catch by eye.

endmenu

source "Kconfig.zephyr"
```

## prj.conf
```kconfig
# Application configuration for the RuuviTag frequency analyzer.
#
# Peripheral *and* broadcaster. Broadcaster-only would keep the attack surface
# at zero, but eight advertisements per spectrum caps the broadcast path at one
# 2.56 s snapshot per ten seconds, and that is not an instrument. See ADR-0002.

CONFIG_BT=y
CONFIG_BT_BROADCASTER=y
CONFIG_BT_PERIPHERAL=y
CONFIG_BT_CENTRAL=n
CONFIG_BT_OBSERVER=n
CONFIG_BT_DEVICE_NAME="RuuviFreq"

# One host at a time. A second connection would halve the radio time available
# to the first and there is no use case for two simultaneous captures.
CONFIG_BT_MAX_CONN=1
CONFIG_BT_MAX_PAIRED=1

# Supervision timeout, in 10 ms units. Zephyr's default is 42 - 420 ms - which
# at the 30-50 ms connection interval below means the link is declared dead
# after roughly 8 to 14 consecutively missed events. On a tag bolted to a steel
# appliance that is one ordinary fade, and it showed up as a connection that
# "intermittently breaks".
#
# 6 s rides out ~120-200 missed events instead. The cost is that a genuinely
# dead link takes 6 s to notice, which matters far less than dropping a live
# one - the collector reconnects either way, and a dropped capture leaves a gap
# in the record.
CONFIG_BT_PERIPHERAL_PREF_TIMEOUT=600

# Throughput. 400 Hz x 3 axes x 2 bytes is 2.4 kB/s of payload, which BLE
# manages comfortably - but only with a large ATT MTU and Data Length
# Extension. At the default 23-byte MTU each notification carries 2 samples and
# the per-packet overhead dominates; at 247 it carries 39.
CONFIG_BT_L2CAP_TX_MTU=247
CONFIG_BT_BUF_ACL_TX_SIZE=251
CONFIG_BT_BUF_ACL_RX_SIZE=251
CONFIG_BT_CTLR_DATA_LENGTH_MAX=251
CONFIG_BT_AUTO_DATA_LEN_UPDATE=y

# 2M PHY halves air time per packet on a part that supports it. The host may
# decline; the stream works either way, just with less headroom. Zephyr 4.x
# runs the PHY update automatically - BT_AUTO_PHY_UPDATE is deprecated and
# setting it is now an error, not a preference.
CONFIG_BT_CTLR_PHY_2M=y

# +4 dBm, the nRF52832's maximum, up from the 0 dBm default. Four decibels is
# roughly 1.6x the range, and range is what decides whether a tag bolted to a
# steel appliance can be reached at all - a tag you cannot hear reports nothing,
# however efficient it is.
#
# BT_CTLR_TX_PWR_DBM follows this automatically, so DF5's TX power field stays
# truthful without touching main.c.
CONFIG_BT_CTLR_TX_PWR_PLUS_4=y

# Extra TX buffers so the notification thread can queue ahead of the radio
# instead of stalling on -ENOMEM every connection interval.
CONFIG_BT_BUF_ACL_TX_COUNT=8

# Hardware float: the nRF52832 is a Cortex-M4F and the broadcast transform runs
# once per 1.28 s, so float is both simpler and cheaper here than fixed point.
CONFIG_FPU=y

# Sensors over SPI: LIS2DH12 accelerometer, BME280 environment.
CONFIG_SENSOR=y
CONFIG_SPI=y

# SAADC, for the coin-cell voltage on DF5's battery field. Without it the tag
# cannot report its own supply and a deployment can only be understood by
# fetching it back.
CONFIG_ADC=y

# GPIO interrupts, for the accelerometer's activity line on INT1 (P0.02).
CONFIG_GPIO=y
# Zephyr's LIS2DH driver has no FIFO support, so src/lis2dh12.c drives the chip
# directly over SPI using the same devicetree node. Leaving the Zephyr driver
# enabled would have two owners configuring one chip.
CONFIG_LIS2DH=n
CONFIG_BME280=y

CONFIG_LOG=y

# Logging over SEGGER RTT. The tag has no exposed UART, and RTT works through
# the same SWD link the DevShield already provides, so this is the only way to
# see a fault message from a running tag.
CONFIG_USE_SEGGER_RTT=y
CONFIG_RTT_CONSOLE=y
CONFIG_UART_CONSOLE=n
CONFIG_LOG_BACKEND_RTT=y
CONFIG_LOG_BACKEND_UART=n
# Deferred, not immediate: the software Link Layer forbids immediate logging
# (it would block in ISR context and wreck radio timing).
CONFIG_LOG_MODE_DEFERRED=y

# Catch a stack overflow as a named error instead of a random hard fault.
CONFIG_THREAD_NAME=y
CONFIG_HW_STACK_PROTECTION=y
CONFIG_EXTRA_EXCEPTION_INFO=y

CONFIG_MAIN_STACK_SIZE=2048
CONFIG_SYSTEM_WORKQUEUE_STACK_SIZE=2048
```

## boards/ruuvi_ruuvitag.overlay
```dts
/*
 * Battery sensing.
 *
 * The board enables the SAADC but declares no channels, so this adds one. It
 * measures the nRF52832's own supply rail through the internal VDD input -
 * there is no divider to wire because the coin cell *is* VDD on a RuuviTag.
 *
 * Gain 1/6 against the internal 0.6 V reference gives a 3.6 V full scale, which
 * covers a fresh CR2477 (~3.0 V) with headroom and still resolves ~0.9 mV per
 * LSB at 12 bits. Anything with a smaller full scale would clip a new cell.
 */

/ {
	zephyr,user {
		io-channels = <&adc 0>;
	};
};

&adc {
	#address-cells = <1>;
	#size-cells = <0>;

	channel@0 {
		reg = <0>;
		zephyr,gain = "ADC_GAIN_1_6";
		zephyr,reference = "ADC_REF_INTERNAL";
		/* 40 us: the internal VDD path is low impedance, but the SAADC
		 * still needs acquisition time to settle its sampling capacitor
		 * and the default is not always enough on nRF52. */
		zephyr,acquisition-time = <ADC_ACQ_TIME(ADC_ACQ_TIME_MICROSECONDS, 40)>;
		zephyr,input-positive = <NRF_SAADC_VDD>;
		zephyr,resolution = <12>;
	};
};
```

## src/main.c
```c
/*
 * RuuviTag frequency analyzer - firmware entry point.
 *
 * Two transports, deliberately different in kind (docs/05-ble-protocol.md):
 *
 *   broadcast  DF5 every slot, except that a queued 0xC2 frame goes out as the
 *              8 slots after a DF5 one. No
 *              connection, any number of listeners. The sensor is duty-cycled
 *              between bursts, so a spectrum arrives once per idle period or
 *              when something moves (power.h).
 *
 *   connected  GATT notifications carrying raw 400 Hz samples. This is what the
 *              analyser uses; the host does the transform.
 *
 * DF5 is emitted unmodified so Ruuvi Station, Ruuvi Gateway and the Home
 * Assistant integration keep working on a tag running this firmware. It pauses
 * while a host is connected, because the stack owns the radio then; see the
 * note above adv_ensure() for why that is the accepted trade.
 */

#include <string.h>

#include <zephyr/bluetooth/bluetooth.h>
#include <zephyr/bluetooth/conn.h>
#include <zephyr/bluetooth/uuid.h>
#include <zephyr/kernel.h>
#include <zephyr/logging/log.h>

#include "adv.h"
#include "battery.h"
#include "env.h"
#include "gatt_stream.h"
#include "leds.h"
#include "power.h"
#include "sampler.h"

LOG_MODULE_REGISTER(rfa, LOG_LEVEL_INF);

/* One payload per advertising interval. Matching the two means the radio never
 * sends the same bytes twice and the CPU never wakes to prepare bytes that are
 * not sent - both of which are pure waste on a battery. */
#define ADV_SLOT_MS CONFIG_RFA_ADV_INTERVAL_MS

/* BLE advertising intervals are in 0.625 ms units. */
#define ADV_UNITS(ms) ((ms) * 8 / 5)

/*
 * FIFO poll period. The hardware FIFO is 32 slots deep; at 400 Hz that is 80 ms
 * of headroom, so polling at 40 ms leaves a 2x margin against a late thread.
 * Sample *timing* does not depend on this - the sensor timestamps samples at its
 * own ODR - so a late poll costs buffer depth, never sample spacing.
 */
#define FIFO_POLL_MS 40

static uint8_t mfg_data[2 + RFA_ADV_PAYLOAD_LEN];

static const struct bt_data adv_ad[] = {
	BT_DATA_BYTES(BT_DATA_FLAGS, BT_LE_AD_GENERAL | BT_LE_AD_NO_BREDR),
	BT_DATA(BT_DATA_MANUFACTURER_DATA, mfg_data, sizeof(mfg_data)),
};

/* The 128-bit service UUID does not fit alongside 24 bytes of manufacturer data
 * in one 31-byte advertisement, so it goes in the scan response. A host
 * filtering for analyser-capable tags does an active scan and sees it there. */
static const struct bt_data adv_sd[] = {
	BT_DATA_BYTES(BT_DATA_UUID128_ALL,
		      BT_UUID_128_ENCODE(0xf1a70001, 0x9c3f, 0x4f5a, 0x8b21, 0x2d6a3c9e7d10)),
	BT_DATA(BT_DATA_NAME_COMPLETE, CONFIG_BT_DEVICE_NAME, sizeof(CONFIG_BT_DEVICE_NAME) - 1),
};

/*
 * BT_LE_ADV_OPT_USE_IDENTITY, not a resolvable private address: DF5 carries the
 * MAC in its payload, and a rotating advertised address would stop a scanner
 * joining the two. Identity is also what makes a tag findable across restarts.
 */
/* No BT_LE_ADV_OPT_SCANNABLE: it is mutually exclusive with _CONN, because
 * legacy connectable advertising (ADV_IND) is already scannable. The scan
 * response still goes out - that is where the service UUID lives. */
static const struct bt_le_adv_param adv_param_conn = BT_LE_ADV_PARAM_INIT(
	BT_LE_ADV_OPT_CONN | BT_LE_ADV_OPT_USE_IDENTITY,
	ADV_UNITS(CONFIG_RFA_ADV_INTERVAL_MS),
	ADV_UNITS(CONFIG_RFA_ADV_INTERVAL_MS) + 16, NULL);

static struct {
	uint8_t  mac[6];
	uint16_t sequence;

	/* Latest broadcast spectrum, and how far through transmitting it we are. */
	uint8_t  spectrum_db[RFA_C2_BINS];
	uint8_t  spectrum_frame;
	uint8_t  spectrum_chunk;
	bool     spectrum_have;
	bool     spectrum_invalid;
} app;

static K_MUTEX_DEFINE(state_lock);

/* DF5 carries the MAC big-endian; Zephyr hands it to us little-endian. */
static void load_identity(void)
{
	bt_addr_le_t addrs[CONFIG_BT_ID_MAX];
	size_t count = ARRAY_SIZE(addrs);

	bt_id_get(addrs, &count);
	if (count == 0) {
		memset(app.mac, 0xFF, sizeof(app.mac));
		return;
	}
	for (int i = 0; i < 6; i++) {
		app.mac[i] = addrs[0].a.val[5 - i];
	}
}

static void build_df5(uint8_t out[RFA_ADV_PAYLOAD_LEN])
{
	struct rfa_df5_fields f;
	struct rfa_env env;
	int16_t dc[3];

	memset(&f, 0, sizeof(f));
	rfa_env_read(&env);
	rfa_sampler_dc(dc);

	if (env.valid) {
		f.temperature = rfa_temp_from_millicelsius(env.temperature_mc);
		f.humidity = rfa_humidity_from_millipercent(env.humidity_mpct);
		f.pressure = rfa_pressure_from_pascal(env.pressure_pa);
	} else {
		f.temperature = RFA_TEMP_INVALID;
		f.humidity = RFA_HUMIDITY_INVALID;
		f.pressure = RFA_PRESSURE_INVALID;
	}

	for (int i = 0; i < 3; i++) {
		f.accel_mg[i] = dc[i];
	}

	/* 0 when the ADC could not be read, which the encoder maps to DF5's
	 * invalid battery code - "not measured" rather than a flat cell. */
	f.battery_mv = rfa_battery_millivolts();

	/* Report what the radio is actually configured for. Claiming +4 dBm
	 * while the controller transmits at 0 puts a 4 dB error into anyone's
	 * path-loss estimate, and the field exists precisely so that estimate is
	 * possible. */
	f.tx_power_dbm = CONFIG_BT_CTLR_TX_PWR_DBM;

	k_mutex_lock(&state_lock, K_FOREVER);
	f.sequence = app.sequence++;
	k_mutex_unlock(&state_lock);

	/* Activity-interrupt events. That is exactly what DF5's movement counter
	 * means in Ruuvi's ecosystem, and watching it is how the motion threshold
	 * gets checked against a real machine. */
	f.movement_counter = rfa_power_movement_counter();

	memcpy(f.mac, app.mac, sizeof(f.mac));
	rfa_encode_df5(&f, out);
}

/*
 * Advertising is re-asserted by the main loop, every slot, forever.
 *
 * Two earlier designs failed on hardware and both are worth recording, because
 * the failure mode is the same and it is the worst one this project has:
 *
 *   1. Restarting advertising inside the connection callbacks. Those run on the
 *      Bluetooth RX thread, and bt_le_adv_start() from there does not work.
 *      The tag went silent the moment a host disconnected.
 *
 *   2. Switching to non-connectable advertising for the duration of a
 *      connection, so DF5 kept flowing during a capture, and switching back on
 *      disconnect. The switch to non-connectable succeeded - RTT confirmed it -
 *      and the tag then never came back. It stayed silent in a mode nothing
 *      was scanning for.
 *
 * So: one mode, connectable, and no cleverness. While a host is connected the
 * stack owns the radio and advertising stops; DF5 pauses for the duration of
 * the capture, which is the price of never going permanently quiet. The moment
 * the connection drops, the next slot starts advertising again, and a start
 * that fails is simply retried on the next slot.
 *
 * A tag that reliably comes back is worth more than one that broadcasts through
 * a capture and then dies.
 */
static atomic_t host_connected = ATOMIC_INIT(0);

static void advertise(const uint8_t payload[RFA_ADV_PAYLOAD_LEN])
{
	int err;

	mfg_data[0] = RFA_RUUVI_COMPANY_ID & 0xFF;   /* company ID is little-endian */
	mfg_data[1] = RFA_RUUVI_COMPANY_ID >> 8;
	memcpy(&mfg_data[2], payload, RFA_ADV_PAYLOAD_LEN);

	err = bt_le_adv_update_data(adv_ad, ARRAY_SIZE(adv_ad), adv_sd, ARRAY_SIZE(adv_sd));
	if (err) {
		LOG_WRN("advertisement update failed (%d)", err);
	}
}

/* Start advertising if it is not already running. -EALREADY is the normal
 * answer and is not worth a log line. */
static void adv_ensure(void)
{
	static bool running;
	int err = bt_le_adv_start(&adv_param_conn, adv_ad, ARRAY_SIZE(adv_ad),
				  adv_sd, ARRAY_SIZE(adv_sd));

	if (err == -EALREADY) {
		running = true;
		return;
	}
	if (err == 0) {
		if (!running) {
			LOG_INF("advertising");
		}
		running = true;
		return;
	}
	running = false;
	LOG_WRN("advertising start failed (%d), retrying next slot", err);
}

static void on_connected(struct bt_conn *conn, uint8_t err)
{
	ARG_UNUSED(conn);
	if (err) {
		return;
	}
	atomic_set(&host_connected, 1);
}

static void on_disconnected(struct bt_conn *conn, uint8_t reason)
{
	ARG_UNUSED(conn); ARG_UNUSED(reason);
	atomic_set(&host_connected, 0);
}

BT_CONN_CB_DEFINE(adv_conn_callbacks) = {
	.connected = on_connected,
	.disconnected = on_disconnected,
};

/* Sampling runs on its own thread so a slow sensor read cannot stretch the
 * advertising cadence. */
static void sample_thread(void *a, void *b, void *c)
{
	ARG_UNUSED(a); ARG_UNUSED(b); ARG_UNUSED(c);

	while (1) {
		if (!rfa_power_sampling()) {
			/* Sensor is in low-power mode and nothing is arriving.
			 * Sleeping here rather than polling at 40 ms is most of
			 * what duty cycling buys: 25 CPU wakes a second become
			 * one, and the FIFO holds nothing worth reading anyway. */
			k_msleep(200);
			continue;
		}

		rfa_sampler_poll();

		/* Pick up a completed transform if one is waiting and the
		 * previous frame has finished transmitting. Overwriting a frame
		 * mid-transmission would splice two spectra into one waterfall
		 * column. */
		k_mutex_lock(&state_lock, K_FOREVER);
		bool idle = !app.spectrum_have;
		k_mutex_unlock(&state_lock);

		if (idle) {
			uint8_t db[RFA_C2_BINS];
			bool invalid = false;

			if (rfa_sampler_spectrum(db, &invalid)) {
				k_mutex_lock(&state_lock, K_FOREVER);
				memcpy(app.spectrum_db, db, sizeof(app.spectrum_db));
				app.spectrum_invalid = invalid;
				app.spectrum_frame++;
				app.spectrum_chunk = 0;
				app.spectrum_have = true;
				k_mutex_unlock(&state_lock);
			}
		}

		k_msleep(FIFO_POLL_MS);
	}
}

/*
 * 4 kB. The transform runs on this thread and rfa_spectrum_bins keeps its
 * working buffers static for exactly that reason; the margin is for the SPI
 * batch and the 128-byte spectrum copy. CONFIG_HW_STACK_PROTECTION turns an
 * overflow here into a named error rather than a random fault.
 */
K_THREAD_DEFINE(rfa_sampler_thread, 4096, sample_thread, NULL, NULL, NULL, 5, 0, 0);

int main(void)
{
	uint8_t payload[RFA_ADV_PAYLOAD_LEN];
	int err;
	int slot = 0;

	LOG_INF("ruuvitag-frequency-analyzer starting");

	err = bt_enable(NULL);
	if (err) {
		LOG_ERR("bluetooth init failed (%d)", err);
		return err;
	}
	load_identity();

	rfa_leds_init();
	rfa_leds_boot();

	if (rfa_sampler_init() < 0) {
		LOG_ERR("accelerometer init failed; no spectra will be produced");
	}
	rfa_env_init();
	rfa_battery_init();
	rfa_gatt_stream_init();
	rfa_power_init();

	build_df5(payload);
	mfg_data[0] = RFA_RUUVI_COMPANY_ID & 0xFF;
	mfg_data[1] = RFA_RUUVI_COMPANY_ID >> 8;
	memcpy(&mfg_data[2], payload, RFA_ADV_PAYLOAD_LEN);

	adv_ensure();
	LOG_INF("advertising as %02X:%02X:%02X:%02X:%02X:%02X",
		app.mac[0], app.mac[1], app.mac[2], app.mac[3], app.mac[4], app.mac[5]);

	while (1) {
		k_msleep(ADV_SLOT_MS);

		if (atomic_get(&host_connected)) {
			/* The stack owns the radio for the duration. Sampling and
			 * the GATT stream carry on; there is nothing to advertise
			 * into. */
			rfa_leds_stream(rfa_gatt_stream_active());
			continue;
		}

		/* Re-assert advertising every slot. Cheap when it is already
		 * running, and the only thing standing between a failed start
		 * and a permanently silent tag. */
		adv_ensure();

		/*
		 * Rotation: DF5, then spectrum chunks until the frame is out.
		 * DF5 keeps its cadence whatever else is queued - Ruuvi
		 * compatibility outranks the broadcast spectrum, which is the
		 * lesser of the two transports anyway.
		 *
		 * While a host is streaming over GATT the broadcast spectrum is
		 * skipped entirely: it would spend radio time duplicating, badly,
		 * data the host already has at full rate.
		 */
		if (slot == 0 || rfa_gatt_stream_active()) {
			slot = 0;
			build_df5(payload);
		} else {
			bool sent = false;

			k_mutex_lock(&state_lock, K_FOREVER);
			if (app.spectrum_have && app.spectrum_chunk < RFA_C2_CHUNKS) {
				rfa_encode_c2(app.spectrum_db, app.spectrum_frame,
					      app.spectrum_chunk, app.spectrum_invalid,
					      payload);
				if (++app.spectrum_chunk >= RFA_C2_CHUNKS) {
					app.spectrum_have = false;
				}
				sent = true;
			}
			k_mutex_unlock(&state_lock);

			if (!sent) {
				/* Nothing queued: fall straight back to DF5 rather
				 * than idling through the spectrum slots. */
				slot = 0;
				build_df5(payload);
			}
		}
		slot = (slot + 1) % (1 + RFA_C2_CHUNKS);

		advertise(payload);
		rfa_leds_advert();
		rfa_leds_stream(rfa_gatt_stream_active());
	}

	return 0;
}
```

## src/adv.h
```c
/*
 * Advertisement encoders.
 *
 * Deliberately free of Zephyr, Nordic and libc dependencies: pure bit packing
 * over plain integers, so they can be compiled into a host unit test against
 * Ruuvi's published vectors. No such C test exists yet: today only the Python
 * decoder is checked against them (tests/test_protocol.py).
 *
 * Field layout: docs/05-ble-protocol.md
 */

#ifndef RFA_ADV_H
#define RFA_ADV_H

#include <stdbool.h>
#include <stdint.h>

#define RFA_RUUVI_COMPANY_ID 0x0499
#define RFA_DF5_FORMAT       0x05
#define RFA_C2_FORMAT        0xC2
#define RFA_ADV_PAYLOAD_LEN  24

/*
 * Format 0xC2 - spectrum frame, the connectionless transport.
 *
 * A full 0-50 Hz spectrum does not fit in one advertisement, so a frame is
 * split across chunks that carry a frame id and a starting bin index. A
 * receiver reassembles by frame id and drops frames it did not hear in full;
 * at the packet loss measured in a house, some frames will be partial and a gap
 * in the waterfall is the honest rendering of that.
 *
 * This is the *broadcast* path: one spectrum roughly every 10 s, no connection,
 * any number of listeners. The GATT stream (gatt_stream.h) is the path for
 * actual analysis work and carries raw samples instead. ADR-0002 explains why
 * both exist.
 *
 * The bin scale is fixed by spec version rather than sent in every chunk -
 * six header bytes already cost a third of a chunk. Version 1 is 100 Hz
 * effective sample rate with a 256-point transform: 0.390625 Hz per bin,
 * 128 bins, 0 to 49.6 Hz.
 *
 * No MAC in the payload, unlike DF5. The BLE advertisement header already
 * carries the address, which is what a scanner joins on anyway, and those six
 * bytes buy a third of another chunk.
 */
#define RFA_C2_SPEC_VERSION  1
#define RFA_C2_BINS          128
#define RFA_C2_BIN_HZ        0.390625f
#define RFA_C2_HEADER_LEN    6
#define RFA_C2_BINS_PER_CHUNK (RFA_ADV_PAYLOAD_LEN - RFA_C2_HEADER_LEN)   /* 18 */
#define RFA_C2_CHUNKS        ((RFA_C2_BINS + RFA_C2_BINS_PER_CHUNK - 1) / RFA_C2_BINS_PER_CHUNK)

#define RFA_C2_FLAG_INVALID  0x01

/* Invalid sentinels, per the Ruuvi spec. A field that could not be measured
 * must carry these rather than a plausible-looking zero. */
#define RFA_TEMP_INVALID     INT16_MIN
#define RFA_HUMIDITY_INVALID UINT16_MAX
#define RFA_PRESSURE_INVALID UINT16_MAX
#define RFA_ACCEL_INVALID    INT16_MIN
#define RFA_SEQ_INVALID      UINT16_MAX
#define RFA_MOVES_INVALID    UINT8_MAX

/* Put this in rfa_df5_fields.battery_mv when no ADC reading is available; the
 * encoder then emits DF5's invalid battery code (11 bits all set). */
#define RFA_BATTERY_NOT_MEASURED 0

/* Raw sensor state, already in DF5's units so the encoder stays dumb. */
struct rfa_df5_fields {
	int16_t  temperature;      /* 0.005 degC/LSB */
	uint16_t humidity;         /* 0.0025 %/LSB   */
	uint16_t pressure;         /* 1 Pa/LSB, already offset by -50000 */
	int16_t  accel_mg[3];      /* mg, the 20 s EMA DC vector */
	uint16_t battery_mv;       /* millivolts, absolute */
	int8_t   tx_power_dbm;
	uint8_t  movement_counter;
	uint16_t sequence;
	uint8_t  mac[6];
};

/* Writes exactly RFA_ADV_PAYLOAD_LEN bytes and cannot fail. */
void rfa_encode_df5(const struct rfa_df5_fields *f, uint8_t out[RFA_ADV_PAYLOAD_LEN]);

/*
 * Encode one chunk of a spectrum frame. `bins_db` holds RFA_C2_BINS values
 * already in the transmitted dB encoding. Bins past the end of the array are
 * padded with zero, which decodes as the floor rather than as missing data.
 */
void rfa_encode_c2(const uint8_t *bins_db, uint8_t frame_id, uint8_t chunk_idx,
		   bool data_invalid, uint8_t out[RFA_ADV_PAYLOAD_LEN]);

/*
 * Amplitude (microg) to the 0xC2 dB encoding: 0.5 dB per LSB referenced to
 * 1 ug, so 0 is 1 ug and 255 is 127.5 dB = 2.37 g. A spectrum spans the noise
 * floor to a hard knock - five orders of magnitude - and a linear byte would
 * quantise the quiet end into two or three distinct values.
 */
uint8_t rfa_spectrum_db(uint32_t magnitude_ug);

/* Helpers that convert real-world units into DF5 encodings, clamping rather
 * than wrapping. Wrapping here would produce a plausible wrong number, which is
 * far worse than a saturated one. */
int16_t  rfa_temp_from_millicelsius(int32_t millicelsius);
uint16_t rfa_humidity_from_millipercent(int32_t millipercent);
uint16_t rfa_pressure_from_pascal(int32_t pascal);
uint16_t rfa_power_field(uint16_t battery_mv, int8_t tx_power_dbm);

#endif /* RFA_ADV_H */
```

## src/adv_df5.c
```c
/*
 * Ruuvi Data Format 5 (RAWv2) encoder.
 *
 * Emitted unmodified so Ruuvi Station, Ruuvi Gateway and the Home Assistant
 * integration keep working (goal G1). Big-endian throughout - DF5 is
 * network-order, unlike almost everything else on this chip.
 */

#include "adv.h"

static void put_u16(uint8_t *p, uint16_t v)
{
	p[0] = (uint8_t)(v >> 8);
	p[1] = (uint8_t)(v & 0xFF);
}

static void put_i16(uint8_t *p, int16_t v)
{
	put_u16(p, (uint16_t)v);
}

void rfa_encode_df5(const struct rfa_df5_fields *f, uint8_t out[RFA_ADV_PAYLOAD_LEN])
{
	out[0] = RFA_DF5_FORMAT;
	put_i16(&out[1], f->temperature);
	put_u16(&out[3], f->humidity);
	put_u16(&out[5], f->pressure);
	put_i16(&out[7], f->accel_mg[0]);
	put_i16(&out[9], f->accel_mg[1]);
	put_i16(&out[11], f->accel_mg[2]);
	put_u16(&out[13], rfa_power_field(f->battery_mv, f->tx_power_dbm));
	out[15] = f->movement_counter;
	put_u16(&out[16], f->sequence);
	for (int i = 0; i < 6; i++) {
		out[18 + i] = f->mac[i];
	}
}

int16_t rfa_temp_from_millicelsius(int32_t millicelsius)
{
	/* 0.005 degC/LSB: value = mC / 5. Range +-163.835 degC, far outside
	 * anything a nursery produces, so clamping is a safety net only. */
	int32_t v = millicelsius / 5;

	if (v > 32767) {
		return 32767;
	}
	if (v < -32767) {
		return -32767;
	}
	return (int16_t)v;
}

uint16_t rfa_humidity_from_millipercent(int32_t millipercent)
{
	/* 0.0025 %/LSB: value = m% / 2.5 = m% * 2 / 5. */
	int32_t v = (millipercent * 2) / 5;

	if (v < 0) {
		return 0;
	}
	if (v > 40000) {   /* 100.00 % */
		return 40000;
	}
	return (uint16_t)v;
}

uint16_t rfa_pressure_from_pascal(int32_t pascal)
{
	/* 1 Pa/LSB with a -50000 Pa offset. Below 50 kPa the format simply
	 * cannot represent the value; report the floor, not a wrapped number. */
	int32_t v = pascal - 50000;

	if (v < 0) {
		return 0;
	}
	if (v > 65534) {
		return 65534;
	}
	return (uint16_t)v;
}

uint16_t rfa_power_field(uint16_t battery_mv, int8_t tx_power_dbm)
{
	/* 11 bits of millivolts above 1600 mV, then 5 bits of TX power as
	 * (dBm + 40) / 2. Both saturate to their invalid code on overflow. */
	uint32_t volt;
	uint32_t tx;

	if (battery_mv == RFA_BATTERY_NOT_MEASURED) {
		/* Emit DF5's invalid code rather than a plausible number. A
		 * fabricated battery reading gets plotted and believed. */
		volt = 2047;
	} else if (battery_mv < 1600) {
		volt = 0;
	} else {
		volt = (uint32_t)(battery_mv - 1600);
		if (volt > 2046) {
			volt = 2046;
		}
	}

	if (tx_power_dbm < -40) {
		tx = 0;
	} else {
		tx = (uint32_t)((tx_power_dbm + 40) / 2);
		if (tx > 30) {
			tx = 30;
		}
	}

	return (uint16_t)((volt << 5) | tx);
}
```

## src/adv_spectrum.c
```c
/*
 * Format 0xC2 - chunked spectrum frames, the broadcast transport.
 *
 * See adv.h for the frame layout and why the bin scale is fixed by spec
 * version rather than transmitted.
 */

#include <math.h>

#include "adv.h"

uint8_t rfa_spectrum_db(uint32_t magnitude_ug)
{
	if (magnitude_ug < 1u) {
		return 0;
	}

	/* 0.5 dB per LSB, referenced to 1 ug. */
	float db = 40.0f * log10f((float)magnitude_ug);

	if (db <= 0.0f) {
		return 0;
	}
	if (db >= 255.0f) {
		return 255;
	}
	return (uint8_t)(db + 0.5f);
}

void rfa_encode_c2(const uint8_t *bins_db, uint8_t frame_id, uint8_t chunk_idx,
		  bool data_invalid, uint8_t out[RFA_ADV_PAYLOAD_LEN])
{
	uint16_t first = (uint16_t)chunk_idx * RFA_C2_BINS_PER_CHUNK;

	out[0] = RFA_C2_FORMAT;
	out[1] = (uint8_t)((RFA_C2_SPEC_VERSION & 0x0F) << 4);
	if (data_invalid) {
		out[1] |= RFA_C2_FLAG_INVALID;
	}
	out[2] = frame_id;
	out[3] = chunk_idx;
	out[4] = RFA_C2_CHUNKS;
	out[5] = (uint8_t)first;

	for (int i = 0; i < RFA_C2_BINS_PER_CHUNK; i++) {
		uint16_t bin = first + (uint16_t)i;

		/* The final chunk runs past the end of the spectrum. Pad with the
		 * floor value rather than leaving the buffer uninitialised - a
		 * receiver cannot tell padding from data, so it must at least be
		 * a value that reads as silence. */
		out[RFA_C2_HEADER_LEN + i] = (bin < RFA_C2_BINS) ? bins_db[bin] : 0;
	}
}
```

## src/battery.c
```c
/*
 * Coin-cell voltage. See battery.h for why it is a warning and not a gauge.
 */

#include <zephyr/devicetree.h>
#include <zephyr/drivers/adc.h>
#include <zephyr/kernel.h>
#include <zephyr/logging/log.h>

#include "battery.h"

LOG_MODULE_REGISTER(rfa_battery, LOG_LEVEL_INF);

static const struct adc_dt_spec vdd =
	ADC_DT_SPEC_GET_BY_IDX(DT_PATH(zephyr_user), 0);

static bool ready;

int rfa_battery_init(void)
{
	int err;

	if (!adc_is_ready_dt(&vdd)) {
		LOG_WRN("ADC not ready; battery will report 'not measured'");
		return -ENODEV;
	}
	err = adc_channel_setup_dt(&vdd);
	if (err < 0) {
		LOG_WRN("ADC channel setup failed (%d)", err);
		return err;
	}
	ready = true;
	return 0;
}

uint16_t rfa_battery_millivolts(void)
{
	if (!ready) {
		return 0;
	}

	int16_t raw = 0;
	struct adc_sequence seq = {
		.buffer = &raw,
		.buffer_size = sizeof(raw),
	};

	if (adc_sequence_init_dt(&vdd, &seq) < 0 || adc_read_dt(&vdd, &seq) < 0) {
		return 0;
	}

	/*
	 * adc_raw_to_millivolts_dt applies the gain and reference from the
	 * devicetree, so the 1/6 gain against the 0.6 V internal reference is
	 * already accounted for here and must not be applied again.
	 */
	int32_t mv = raw;

	if (adc_raw_to_millivolts_dt(&vdd, &mv) < 0) {
		return 0;
	}
	if (mv < 0) {
		/* The SAADC is signed and reads slightly negative near zero. A
		 * negative supply is not a measurement. */
		return 0;
	}
	if (mv > UINT16_MAX) {
		mv = UINT16_MAX;
	}
	return (uint16_t)mv;
}
```

## src/battery.h
```c
/*
 * Coin-cell voltage, through the SAADC's internal VDD input.
 *
 * This exists because a tag that cannot report its own supply cannot be left on
 * a battery and understood. Without it DF5 carries the "not measured" code, and
 * the only way to know how a deployment is going is to go and fetch the tag.
 *
 * Reading VDD is not a fuel gauge. A CR2477 holds ~3.0 V across most of its
 * life and then falls off a cliff, so the voltage says "fine" for a year and
 * "nearly done" for a week. It is a warning, not a percentage, and nothing here
 * converts it into one.
 */

#ifndef RFA_BATTERY_H
#define RFA_BATTERY_H

#include <stdint.h>

int rfa_battery_init(void);

/*
 * Supply voltage in millivolts, or 0 if it could not be read.
 *
 * 0 is deliberate: build_df5() maps it to DF5's invalid battery code, so a
 * failed ADC reads as "not measured" rather than as a flat cell. A fabricated
 * voltage gets plotted and believed.
 */
uint16_t rfa_battery_millivolts(void);

#endif /* RFA_BATTERY_H */
```

## src/env.c
```c
/*
 * BME280 temperature / humidity / pressure.
 *
 * The upstream RuuviTag board devicetree instantiates a BME280. Newer tag
 * revisions ship SHTC3 + DPS310 instead; that is TODO(hw-2) in
 * docs/01-hardware.md and is a devicetree-overlay change, not a code change,
 * because everything below goes through the Zephyr sensor API.
 */

#include <string.h>

#include <zephyr/device.h>
#include <zephyr/drivers/sensor.h>
#include <zephyr/logging/log.h>

#include "env.h"

LOG_MODULE_REGISTER(rfa_env, LOG_LEVEL_INF);

#define ENV_NODE DT_COMPAT_GET_ANY_STATUS_OKAY(bosch_bme280)

#if DT_NODE_HAS_STATUS(ENV_NODE, okay)
static const struct device *const env_dev = DEVICE_DT_GET(ENV_NODE);
#else
static const struct device *const env_dev;
#endif

int rfa_env_init(void)
{
	if (env_dev == NULL || !device_is_ready(env_dev)) {
		LOG_WRN("environmental sensor unavailable; DF5 will carry invalid codes");
		return -ENODEV;
	}
	LOG_INF("environmental sensor ready");
	return 0;
}

void rfa_env_read(struct rfa_env *out)
{
	struct sensor_value t, h, p;

	memset(out, 0, sizeof(*out));

	if (env_dev == NULL || !device_is_ready(env_dev)) {
		return;
	}
	if (sensor_sample_fetch(env_dev) < 0) {
		return;
	}
	if (sensor_channel_get(env_dev, SENSOR_CHAN_AMBIENT_TEMP, &t) < 0 ||
	    sensor_channel_get(env_dev, SENSOR_CHAN_HUMIDITY, &h) < 0 ||
	    sensor_channel_get(env_dev, SENSOR_CHAN_PRESS, &p) < 0) {
		return;
	}

	out->temperature_mc = t.val1 * 1000 + t.val2 / 1000;
	out->humidity_mpct = h.val1 * 1000 + h.val2 / 1000;
	/* Zephyr reports pressure in kilopascal. */
	out->pressure_pa = p.val1 * 1000 + p.val2 / 1000;
	out->valid = true;
}
```

## src/env.h
```c
/*
 * Environmental sensing. Temperature and humidity are not filler: safe-sleep
 * guidance cares about nursery temperature, and these come free with the
 * hardware (docs/05-advertising-format.md).
 */

#ifndef RFA_ENV_H
#define RFA_ENV_H

#include <stdbool.h>
#include <stdint.h>

struct rfa_env {
	int32_t temperature_mc;   /* millidegrees C */
	int32_t humidity_mpct;    /* milli-percent RH */
	int32_t pressure_pa;
	bool    valid;            /* false -> emit DF5 invalid sentinels */
};

int rfa_env_init(void);
void rfa_env_read(struct rfa_env *out);

#endif /* RFA_ENV_H */
```

## src/fft.c
```c
/*
 * Radix-2 FFT and the transmitted magnitude encoding.
 */

#include <math.h>
#include <string.h>

#include "fft.h"

#ifndef M_PIf
#define M_PIf 3.14159265358979323846f
#endif

void rfa_fft(float *re, float *im, int n)
{
	/* Bit-reversal permutation. */
	for (int i = 1, j = 0; i < n; i++) {
		int bit = n >> 1;

		for (; j & bit; bit >>= 1) {
			j ^= bit;
		}
		j ^= bit;
		if (i < j) {
			float t = re[i]; re[i] = re[j]; re[j] = t;
			t = im[i]; im[i] = im[j]; im[j] = t;
		}
	}

	for (int len = 2; len <= n; len <<= 1) {
		float ang = -2.0f * M_PIf / (float)len;
		float wr = cosf(ang), wi = sinf(ang);

		for (int i = 0; i < n; i += len) {
			float cr = 1.0f, ci = 0.0f;

			for (int k = 0; k < len / 2; k++) {
				float ur = re[i + k], ui = im[i + k];
				float vr = re[i + k + len / 2] * cr - im[i + k + len / 2] * ci;
				float vi = re[i + k + len / 2] * ci + im[i + k + len / 2] * cr;

				re[i + k] = ur + vr;
				im[i + k] = ui + vi;
				re[i + k + len / 2] = ur - vr;
				im[i + k + len / 2] = ui - vi;

				/* Twiddle recurrence. Cheap, and the drift over
				 * 128 steps is far below our resolution. */
				float nr = cr * wr - ci * wi;

				ci = cr * wi + ci * wr;
				cr = nr;
			}
		}
	}
}

void rfa_spectrum_bins(const float *samples_ug, int n, uint8_t *out_db, int n_bins)
{
	/* Static, not automatic: 256 floats each is 2 kB of stack between them,
	 * which overflows the sampler thread. One caller, one thread. */
	static float re[RFA_WF_N];
	static float im[RFA_WF_N];

	for (int i = 0; i < n_bins; i++) {
		out_db[i] = 0;
	}
	if (n <= 0 || n > RFA_WF_N || n_bins <= 0) {
		return;
	}

	/* Mean removal. Residual DC dominates bin 0 and leaks into its
	 * neighbours - 0.39 and 0.78 Hz - which is inside the band of interest. */
	float mean = 0.0f;

	for (int i = 0; i < n; i++) {
		mean += samples_ug[i];
	}
	mean /= (float)n;

	/* Hann window: a rectangular window's sidelobes would smear a strong
	 * low-frequency component across the whole band. */
	float sum_w = 0.0f;

	for (int i = 0; i < RFA_WF_N; i++) {
		if (i < n) {
			float w = 0.5f * (1.0f - cosf(2.0f * M_PIf * (float)i / (float)(n - 1)));

			re[i] = (samples_ug[i] - mean) * w;
			sum_w += w;
		} else {
			re[i] = 0.0f;   /* zero-pad a short window */
		}
		im[i] = 0.0f;
	}
	rfa_fft(re, im, RFA_WF_N);

	if (sum_w <= 0.0f) {
		return;
	}

	const int half = RFA_WF_N / 2;
	const int lim = n_bins < half ? n_bins : half;

	/*
	 * Coherent-gain normalisation: A = 2 |X_k| / sum(w), so a bin reads the
	 * amplitude in microg of a tone sitting on it. Same convention as the
	 * host's webapp/dsp.py, which is what lets a broadcast spectrum be laid
	 * over a host-computed one and compared.
	 *
	 * Not the Parseval form sqrt(4|X|^2 / (N * sum_w2)): that one is correct
	 * only when summed across the whole main lobe, and used per bin it reads
	 * an on-centre tone 18% low, because a Hann window puts only half the
	 * amplitude in the centre bin. tests/test_dsp.py pins this down.
	 */
	for (int i = 0; i < lim; i++) {
		float p = re[i] * re[i] + im[i] * im[i];
		float amp = 2.0f * sqrtf(p) / sum_w;

		out_db[i] = amp < 1.0f ? 0 : (uint8_t)fminf(255.0f, 40.0f * log10f(amp) + 0.5f);
	}
}
```

## src/fft.h
```c
/*
 * The on-tag transform, for the connectionless broadcast path only.
 *
 * This exists so a tag nobody is connected to still reports something. The
 * analysis anyone actually reads happens on the host from the GATT sample
 * stream, where the window, the overlap and the transform length are settings
 * rather than compile-time constants (ADR-0003). Do not grow this file: every
 * feature added here is a feature that needs a reflash to change.
 *
 * Dependency-free apart from libm, so it runs under host tests against
 * synthetic signals with known answers. Single-precision throughout: the
 * nRF52832 is a Cortex-M4F, so float is both simpler and cheaper here than
 * fixed point.
 */

#ifndef RFA_FFT_H
#define RFA_FFT_H

#include <stdint.h>

/*
 * 256 points at the 100 Hz analysis stage: 0.390625 Hz bins over 0-50 Hz, from
 * a 2.56 s window. That resolution and that window length are the same fact -
 * dF x dT ~ 1 is not a design choice, and no amount of overlap buys resolution
 * the window length does not already contain.
 */
#define RFA_WF_N 256
#define RFA_WF_BINS 128

/*
 * Hop between transforms, in samples of the 100 Hz stage. 128 is 50% overlap:
 * a new spectrum every 1.28 s.
 *
 * There is no point going faster on this path. A frame takes 8 advertisements
 * to transmit, which at the default 1 s advertising slot is ~8 s - so the
 * transform is already running ~6x faster than the radio can drain it, and the
 * broadcast spectrum is a periodic snapshot rather than a continuous record.
 * Continuity is what the GATT stream is for.
 */
#define RFA_WF_HOP 128

/* In-place radix-2 complex FFT. n must be a power of two. */
void rfa_fft(float *re, float *im, int n);

/*
 * Full magnitude spectrum, encoded for transmission: one byte per bin at
 * 0.5 dB/LSB referenced to 1 ug (see rfa_spectrum_db in adv.h).
 *
 * n must be RFA_WF_N. Writes n_bins values covering DC to n/2. Hann window and
 * mean removal, coherent-gain normalised so a tone on a bin centre reads its
 * true amplitude. Between centres it reads up to 1.42 dB low (scalloping);
 * nothing here corrects that - the host's dominant_peak does.
 */
void rfa_spectrum_bins(const float *samples_ug, int n, uint8_t *out_db, int n_bins);

#endif /* RFA_FFT_H */
```

## src/gatt_stream.c
```c
/*
 * Raw sample streaming over GATT. See gatt_stream.h for the wire format.
 */

#include <string.h>

#include <zephyr/bluetooth/bluetooth.h>
#include <zephyr/bluetooth/conn.h>
#include <zephyr/bluetooth/gatt.h>
#include <zephyr/bluetooth/uuid.h>
#include <zephyr/kernel.h>
#include <zephyr/logging/log.h>
#include <zephyr/sys/byteorder.h>

#include "battery.h"
#include "gatt_stream.h"
#include "lis2dh12.h"
#include "power.h"
#include "sampler.h"

LOG_MODULE_REGISTER(rfa_gatt, LOG_LEVEL_INF);

#define UUID_BASE(w) BT_UUID_128_ENCODE(0xf1a70000 | (w), 0x9c3f, 0x4f5a, 0x8b21, 0x2d6a3c9e7d10)

static struct bt_uuid_128 uuid_service = BT_UUID_INIT_128(UUID_BASE(1));
static struct bt_uuid_128 uuid_samples = BT_UUID_INIT_128(UUID_BASE(2));
static struct bt_uuid_128 uuid_control = BT_UUID_INIT_128(UUID_BASE(3));
static struct bt_uuid_128 uuid_info    = BT_UUID_INIT_128(UUID_BASE(4));
static struct bt_uuid_128 uuid_stats   = BT_UUID_INIT_128(UUID_BASE(5));

static struct {
	struct bt_conn *conn;
	bool subscribed;      /* CCC enabled */
	bool started;         /* host wrote START */
	uint32_t sent;
	uint32_t gaps;
} gs;

static K_SEM_DEFINE(wake, 0, 1);

bool rfa_gatt_stream_active(void)
{
	return gs.conn && gs.subscribed && gs.started;
}

/*
 * Info characteristic. The host must never have to assume a sample rate: the
 * LIS2DH12's ODR comes from an RC oscillator that is a few percent off nominal
 * and drifts with temperature, and a 3% rate error is a 3% error on every
 * frequency the analyser draws (S-6). Reading this is how the host learns the
 * measured rate rather than the label.
 */
static ssize_t read_info(struct bt_conn *conn, const struct bt_gatt_attr *attr,
			 void *buf, uint16_t len, uint16_t offset)
{
	uint8_t info[12];

	info[0] = RFA_STREAM_PROTO_VERSION;
	info[1] = 3;                                    /* axes */
	sys_put_le32(rfa_lis2dh12_nominal_hz() * 1000u, &info[2]);
	sys_put_le32(rfa_sampler_measured_mhz(), &info[6]);
	info[10] = 1;                                   /* 1 mg per int16 LSB */
	info[11] = 2;                                   /* +/- 2 g full scale */

	return bt_gatt_attr_read(conn, attr, buf, len, offset, info, sizeof(info));
}

/* See RFA_STATS_LEN in the header for the layout and why it exists. */
static ssize_t read_stats(struct bt_conn *conn, const struct bt_gatt_attr *attr,
			  void *buf, uint16_t len, uint16_t offset)
{
	struct rfa_power_stats ps;
	uint8_t out[RFA_STATS_LEN];

	rfa_power_stats(&ps);

	sys_put_le32(ps.uptime_s, &out[0]);
	sys_put_le32(ps.idle_ms, &out[4]);
	sys_put_le32(ps.burst_ms, &out[8]);
	sys_put_le32(ps.active_ms, &out[12]);
	sys_put_le16(ps.bursts, &out[16]);
	sys_put_le16(ps.motion_events, &out[18]);
	sys_put_le16(rfa_battery_millivolts(), &out[20]);

	return bt_gatt_attr_read(conn, attr, buf, len, offset, out, sizeof(out));
}

static ssize_t write_control(struct bt_conn *conn, const struct bt_gatt_attr *attr,
			     const void *buf, uint16_t len, uint16_t offset, uint8_t flags)
{
	ARG_UNUSED(attr); ARG_UNUSED(conn); ARG_UNUSED(flags);

	if (offset != 0 || len < 1) {
		return BT_GATT_ERR(BT_ATT_ERR_INVALID_ATTRIBUTE_LEN);
	}

	switch (((const uint8_t *)buf)[0]) {
	case RFA_STREAM_CMD_START:
		/* Takes the sensor to continuous 400 Hz and then drops whatever
		 * accumulated while nobody was listening. Both happen on the
		 * workqueue and in that order - see streaming_fn() in power.c,
		 * which is also why the cursor is not reset here. */
		rfa_power_set_streaming(true);
		gs.started = true;
		gs.sent = 0;
		gs.gaps = 0;
		k_sem_give(&wake);
		LOG_INF("stream started");
		break;
	case RFA_STREAM_CMD_STOP:
		gs.started = false;
		rfa_power_set_streaming(false);
		LOG_INF("stream stopped after %u packets, %u gaps", gs.sent, gs.gaps);
		break;
	case RFA_STREAM_CMD_THRESHOLD: {
		if (len < 3) {
			return BT_GATT_ERR(BT_ATT_ERR_INVALID_ATTRIBUTE_LEN);
		}
		uint16_t mg = sys_get_le16(&((const uint8_t *)buf)[1]);

		if (rfa_power_set_motion_threshold(mg) < 0) {
			return BT_GATT_ERR(BT_ATT_ERR_VALUE_NOT_ALLOWED);
		}
		LOG_INF("motion threshold set to %u mg (not persisted)", mg);
		break;
	}
	default:
		return BT_GATT_ERR(BT_ATT_ERR_VALUE_NOT_ALLOWED);
	}
	return len;
}

static void ccc_changed(const struct bt_gatt_attr *attr, uint16_t value)
{
	ARG_UNUSED(attr);
	gs.subscribed = (value == BT_GATT_CCC_NOTIFY);
	if (!gs.subscribed) {
		gs.started = false;
		rfa_power_set_streaming(false);
	}
	LOG_INF("notifications %s", gs.subscribed ? "on" : "off");
}

BT_GATT_SERVICE_DEFINE(rfa_stream_svc,
	BT_GATT_PRIMARY_SERVICE(&uuid_service),

	BT_GATT_CHARACTERISTIC(&uuid_samples.uuid, BT_GATT_CHRC_NOTIFY,
			       BT_GATT_PERM_NONE, NULL, NULL, NULL),
	BT_GATT_CCC(ccc_changed, BT_GATT_PERM_READ | BT_GATT_PERM_WRITE),

	BT_GATT_CHARACTERISTIC(&uuid_control.uuid, BT_GATT_CHRC_WRITE,
			       BT_GATT_PERM_WRITE, NULL, write_control, NULL),

	BT_GATT_CHARACTERISTIC(&uuid_info.uuid, BT_GATT_CHRC_READ,
			       BT_GATT_PERM_READ, read_info, NULL, NULL),

	BT_GATT_CHARACTERISTIC(&uuid_stats.uuid, BT_GATT_CHRC_READ,
			       BT_GATT_PERM_READ, read_stats, NULL, NULL),
);

/* Attribute 1 is the Samples value; notifying on the characteristic
 * declaration is the documented Zephyr idiom for "this characteristic". */
#define SAMPLES_ATTR (&rfa_stream_svc.attrs[1])

static void connected(struct bt_conn *conn, uint8_t err)
{
	if (err) {
		LOG_WRN("connection failed (0x%02x)", err);
		return;
	}
	gs.conn = bt_conn_ref(conn);
	LOG_INF("host connected");
}

static void disconnected(struct bt_conn *conn, uint8_t reason)
{
	ARG_UNUSED(conn);
	LOG_INF("host disconnected (0x%02x)", reason);
	if (gs.conn) {
		bt_conn_unref(gs.conn);
		gs.conn = NULL;
	}
	gs.subscribed = false;
	gs.started = false;
	/* A host that vanishes without writing STOP must not leave the sensor at
	 * 400 Hz forever. This is the path that actually matters on a battery. */
	rfa_power_set_streaming(false);
}

BT_CONN_CB_DEFINE(conn_callbacks) = {
	.connected = connected,
	.disconnected = disconnected,
};

/*
 * How many samples fit in one notification, given the negotiated MTU.
 *
 * Computed per packet rather than latched at connect: MTU exchange is initiated
 * by the central and may land after the first notification goes out. Assuming
 * the large MTU before it is agreed produces a silent truncation, which on this
 * wire format would corrupt sample alignment for the rest of the connection.
 */
static uint16_t samples_per_packet(struct bt_conn *conn)
{
	uint16_t mtu = bt_gatt_get_mtu(conn);
	int payload = (int)mtu - 3 - RFA_STREAM_HEADER_LEN;

	if (payload < RFA_STREAM_BYTES_PER_SAMPLE) {
		return 0;
	}
	return (uint16_t)(payload / RFA_STREAM_BYTES_PER_SAMPLE);
}

static void stream_thread(void *a, void *b, void *c)
{
	ARG_UNUSED(a); ARG_UNUSED(b); ARG_UNUSED(c);

	/* Sized from the configured MTU, so raising CONFIG_BT_L2CAP_TX_MTU
	 * cannot silently outgrow the buffer that carries its packets. */
	static uint8_t pkt[CONFIG_BT_L2CAP_TX_MTU];
	static struct rfa_sample samples[(CONFIG_BT_L2CAP_TX_MTU - RFA_STREAM_HEADER_LEN)
					 / RFA_STREAM_BYTES_PER_SAMPLE];

	while (1) {
		if (!rfa_gatt_stream_active()) {
			k_sem_take(&wake, K_MSEC(200));
			continue;
		}

		struct bt_conn *conn = gs.conn;
		uint16_t cap = samples_per_packet(conn);

		if (cap == 0) {
			k_msleep(20);
			continue;
		}
		if (cap > ARRAY_SIZE(samples)) {
			cap = ARRAY_SIZE(samples);
		}

		uint32_t first;
		bool gap;
		size_t n = rfa_sampler_stream_read(samples, cap, &first, &gap);

		if (n == 0) {
			/* Ring empty. At 400 Hz a full packet accumulates in
			 * ~100 ms; sleeping a fraction of that keeps latency low
			 * without spinning. */
			k_msleep(10);
			continue;
		}

		pkt[0] = (RFA_STREAM_PROTO_VERSION << 4) | (gap ? RFA_STREAM_FLAG_GAP : 0);
		pkt[1] = (uint8_t)n;
		sys_put_le32(first, &pkt[2]);
		for (size_t i = 0; i < n; i++) {
			uint8_t *p = &pkt[RFA_STREAM_HEADER_LEN + i * RFA_STREAM_BYTES_PER_SAMPLE];

			sys_put_le16((uint16_t)samples[i].mg[0], p);
			sys_put_le16((uint16_t)samples[i].mg[1], p + 2);
			sys_put_le16((uint16_t)samples[i].mg[2], p + 4);
		}

		int err = bt_gatt_notify(conn, SAMPLES_ATTR, pkt,
					 RFA_STREAM_HEADER_LEN + n * RFA_STREAM_BYTES_PER_SAMPLE);

		if (err == -ENOMEM || err == -EAGAIN) {
			/*
			 * Out of ACL buffers: the radio has not drained what we
			 * already queued. Back off and let it. The samples stay
			 * in the ring, and if we stall long enough to overflow
			 * it the gap flag reports that honestly rather than the
			 * host seeing a seamless stream that quietly lost time.
			 */
			k_msleep(5);
			continue;
		}
		if (err) {
			LOG_WRN("notify failed (%d)", err);
			k_msleep(50);
			continue;
		}
		gs.sent++;
		if (gap) {
			gs.gaps++;
		}
	}
}

K_THREAD_DEFINE(rfa_streamer, 2048, stream_thread, NULL, NULL, NULL, 6, 0, 0);

void rfa_gatt_stream_init(void)
{
	memset(&gs, 0, sizeof(gs));
	LOG_INF("stream service registered");
}
```
